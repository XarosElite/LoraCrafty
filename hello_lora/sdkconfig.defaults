## hello_lora/sdkconfig.defaults
```kconfig
# USB-Serial/JTAG port instead of UART0 for console
CONFIG_ESP_CONSOLE_USB_SERIAL_JTAG=y

# Make sure JTAG-USB stays enabled
CONFIG_ESP_DEBUG_OCDAWARE=y
CONFIG_ESP_SYSTEM_PANIC_PRINT_REBOOT=y
```
